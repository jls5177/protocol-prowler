## drivers/Kconfig
```kconfig
# Copyright (c) 2024 Justin Simon
# SPDX-License-Identifier: Apache-2.0

menu "Drivers"

endmenu
```

## lib/Kconfig
```kconfig
# Copyright (c) 2024 Justin Simon
# SPDX-License-Identifier: Apache-2.0

menu "Custom libraries"

endmenu
```
